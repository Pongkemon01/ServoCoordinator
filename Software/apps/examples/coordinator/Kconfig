## Software/apps/examples/coordinator/Kconfig
```kconfig
#
# For a description of the syntax of this configuration file,
# see the file kconfig-language.txt in the NuttX tools repository.
#

config EXAMPLES_COORDINATOR
	tristate "\"Motor coordinator for PTTEP\""
	default n
	---help---
		Enable the \"Motor coordinator for PTTEP\" example

if EXAMPLES_COORDINATOR

config EXAMPLES_COORDINATOR_PROGNAME
	string "Program name"
	default "coordinator"
	depends on BUILD_LOADABLE
	---help---
		This is the name of the program that will be used when the NSH ELF
		program is installed.

config EXAMPLES_COORDINATOR_PRIORITY
	int "Coordinator task priority"
	default 100

config EXAMPLES_COORDINATOR_STACKSIZE
	int "Coordinator stack size"
	default 2048

endif
```
